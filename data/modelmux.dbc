VERSION "1.0"

NS_ :

BU_ :

BO_ 2024 OBD2: 8 Vector__XXX
	SG_ VehicleSpeed m13 : 31|8@0+ (1,0) [0|255] "km/h" Vector__XXX
	SG_ ThrottlePosition m17 : 31|8@0+ (0.39216,0) [0|100] "%" Vector__XXX
	SG_ S1 m1M : 23|8@0+ (1,0) [0|255] "" Vector__XXX
	SG_ S2 m2 : 23|8@0+ (1,0) [0|255] "" Vector__XXX
	SG_ Service M : 11|4@0+ (1,0) [0|15] "" Vector__XXX

SG_MUL_VAL_ 2024 VehicleSpeed S1 13-13 ;
SG_MUL_VAL_ 2024 ThrottlePosition S1 17-17 ;
SG_MUL_VAL_ 2024 S1 Service 1-1 ;
SG_MUL_VAL_ 2024 S2 Service 2-2 ;
