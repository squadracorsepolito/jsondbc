VERSION "1.0"

NS_ :

BS_ :

BU_ : Node1 Node2

BO_ 2364540158 EEC1: 8 Vector__XXX
	SG_ Engine_Status : 0|2@1+ (0,0) [0|2] "status" Vector__XXX
	SG_ Engine_Speed : 24|16@0+ (0.125,0) [0|8031.875] "rpm" Node1,Node2

CM_ "Baudrate: 1000000";
CM_ BU_ Node1 "Node1 desc";
CM_ BU_ Node2 "Node2 desc";
CM_ BO_ 2364540158 "desc 0 (period: 100 ms)";
CM_ SG_ 2364540158 Engine_Speed "desc 1";
CM_ SG_ 2364540158 Engine_Status "desc 2";

BA_DEF_ "FloatAtt" FLOAT 0 25.75;
BA_DEF_ "Baudrate" INT 0 1000000;
BA_DEF_ BU_ "TestString" STRING ;
BA_DEF_ BO_ "VFrameFormat" ENUM "StandardCAN","ExtendedCAN","reserved","J1939PG";
BA_DEF_ BO_ "MsgPeriodMS" INT 0 65535;
BA_DEF_ SG_ "SPN" INT 0 524287;
BA_DEF_ SG_ "TestFloatAtt" FLOAT 0 25.75;
BA_DEF_DEF_ "FloatAtt" 1.5;
BA_DEF_DEF_ "Baudrate" 1000000;
BA_DEF_DEF_ "TestString" "";
BA_DEF_DEF_ "VFrameFormat" "J1939PG";
BA_DEF_DEF_ "MsgPeriodMS" 0;
BA_DEF_DEF_ "SPN" 0;
BA_DEF_DEF_ "TestFloatAtt" 1.5;
BA_ "TestString" BU_ Node2 "test";
BA_ "VFrameFormat" BO_ 2364540158 0;
BA_ "MsgPeriodMS" BO_ 2364540158 100;
BA_ "SPN" SG_ 2364540158 Engine_Speed 190;
BA_ "TestFloatAtt" SG_ 2364540158 Engine_Speed 10.5;

VAL_ 2364540158 Engine_Status 0 "Off" 1 "Idle" 2 "Running";
